## firmware/components/wifi_controller/Kconfig.projbuild
```kconfig
menu "Wi-Fi Controller"
	config SCAN_MAX_AP
			int "Maximun AP scanned"
			default 20
			help
			Maximum number of scanned nearby AP
	menu "Manager AP"
			config MANAGER_AP_SSID
					string "Manager AP SSID"
					default "MININO_MANAGER"
					help
					SSID of management AP

			config MANAGER_AP_PASSWORD
					string "Manager AP Password"
					default "minino1234"
					help
					Password for management AP WPA2 (minimum 8 characters)

			config MANAGER_AP_CHANNEL
					int "Manager AP channel"
					range 1 13
					default 3
					help
					Channel on which management AP should run

			config MANAGER_AP_MAX_CONNECTIONS
					int "Maximum number of connected clients"
					range 0 10
					default 1
					help
					Password for management AP

			config MANAGER_AP_AUTH_ON
					bool "Password protected management AP"
					default y
					help
							If set to true, WPA2-PSK will be used. Otherwise authentication will be open
							and anyone can connect to this management AP.
	endmenu
endmenu
```
