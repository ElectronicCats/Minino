## examples/ESP-IDF/minino/main/Kconfig.projbuild
```kconfig
menu "Frequency Configuration"

    choice EXAMPLE_MAX_CPU_FREQ
        prompt "Maximum CPU frequency"
        default EXAMPLE_MAX_CPU_FREQ_80 if !IDF_TARGET_ESP32H2
        default EXAMPLE_MAX_CPU_FREQ_96 if IDF_TARGET_ESP32H2
        depends on PM_ENABLE
        help
            Maximum CPU frequency to use for dynamic frequency scaling.

        config EXAMPLE_MAX_CPU_FREQ_80
            bool "80 MHz"
        config EXAMPLE_MAX_CPU_FREQ_96
            bool "96 MHz"
            depends on IDF_TARGET_ESP32H2
        config EXAMPLE_MAX_CPU_FREQ_120
            bool "120 MHz"
            depends on IDF_TARGET_ESP32C2
        config EXAMPLE_MAX_CPU_FREQ_160
            bool "160 MHz"
            depends on !IDF_TARGET_ESP32C2
        config EXAMPLE_MAX_CPU_FREQ_240
            bool "240 MHz"
            depends on IDF_TARGET_ESP32 || IDF_TARGET_ESP32S2 || IDF_TARGET_ESP32S3
    endchoice

    config EXAMPLE_MAX_CPU_FREQ_MHZ
        int
        default 80 if EXAMPLE_MAX_CPU_FREQ_80
        default 96 if EXAMPLE_MAX_CPU_FREQ_96
        default 120 if EXAMPLE_MAX_CPU_FREQ_120
        default 160 if EXAMPLE_MAX_CPU_FREQ_160
        default 240 if EXAMPLE_MAX_CPU_FREQ_240

    choice EXAMPLE_MIN_CPU_FREQ
        prompt "Minimum CPU frequency"
        default EXAMPLE_MIN_CPU_FREQ_10M if !IDF_TARGET_ESP32H2
        default EXAMPLE_MIN_CPU_FREQ_32M if IDF_TARGET_ESP32H2
        depends on PM_ENABLE
        help
            Minimum CPU frequency to use for dynamic frequency scaling.
            Should be set to XTAL frequency or XTAL frequency divided by integer.

        config EXAMPLE_MIN_CPU_FREQ_40M
            bool "40 MHz (use with 40MHz XTAL)"
            depends on XTAL_FREQ_40 || XTAL_FREQ_AUTO || ESP32_XTAL_FREQ_40 || ESP32_XTAL_FREQ_AUTO || !IDF_TARGET_ESP32
        config EXAMPLE_MIN_CPU_FREQ_20M
            bool "20 MHz (use with 40MHz XTAL)"
            depends on XTAL_FREQ_40 || XTAL_FREQ_AUTO || ESP32_XTAL_FREQ_40 || ESP32_XTAL_FREQ_AUTO || !IDF_TARGET_ESP32
        config EXAMPLE_MIN_CPU_FREQ_10M
            bool "10 MHz (use with 40MHz XTAL)"
            depends on XTAL_FREQ_40 || XTAL_FREQ_AUTO || ESP32_XTAL_FREQ_40 || ESP32_XTAL_FREQ_AUTO || !IDF_TARGET_ESP32
        config EXAMPLE_MIN_CPU_FREQ_26M
            bool "26 MHz (use with 26MHz XTAL)"
            depends on XTAL_FREQ_26 || XTAL_FREQ_AUTO || ESP32_XTAL_FREQ_26 || ESP32_XTAL_FREQ_AUTO
        config EXAMPLE_MIN_CPU_FREQ_13M
            bool "13 MHz (use with 26MHz XTAL)"
            depends on XTAL_FREQ_26 || XTAL_FREQ_AUTO || ESP32_XTAL_FREQ_26 || ESP32_XTAL_FREQ_AUTO
        config EXAMPLE_MIN_CPU_FREQ_32M
            bool "32 MHz (use with 32MHz XTAL)"
            depends on IDF_TARGET_ESP32H2
            depends on XTAL_FREQ_32 || XTAL_FREQ_AUTO
    endchoice

    config EXAMPLE_MIN_CPU_FREQ_MHZ
        int
        default 40 if EXAMPLE_MIN_CPU_FREQ_40M
        default 20 if EXAMPLE_MIN_CPU_FREQ_20M
        default 10 if EXAMPLE_MIN_CPU_FREQ_10M
        default 26 if EXAMPLE_MIN_CPU_FREQ_26M
        default 13 if EXAMPLE_MIN_CPU_FREQ_13M
        default 32 if EXAMPLE_MIN_CPU_FREQ_32M

    choice EXAMPLE_LCD_CONTROLLER
        prompt "LCD controller model"
        default EXAMPLE_LCD_CONTROLLER_SSD1306
        help
            Select LCD controller model

        config EXAMPLE_LCD_CONTROLLER_SSD1306
            bool "SSD1306"

        config EXAMPLE_LCD_CONTROLLER_SH1107
            bool "SH1107"
    endchoice

    if EXAMPLE_LCD_CONTROLLER_SSD1306
        choice EXAMPLE_SSD1306_HEIGHT
            prompt "SSD1306 Height in pixels"
            default EXAMPLE_SSD1306_HEIGHT_64
            help
                Height of the display in pixels. a.k.a vertical resolution

            config EXAMPLE_SSD1306_HEIGHT_64
                bool "64"
            config EXAMPLE_SSD1306_HEIGHT_32
                bool "32"
        endchoice

        config EXAMPLE_SSD1306_HEIGHT
            int
            default 64 if EXAMPLE_SSD1306_HEIGHT_64
            default 32 if EXAMPLE_SSD1306_HEIGHT_32
    endif

endmenu

menu "OpenThread CLI Configuration"

    config OPENTHREAD_AUTO_START
        bool 'Enable the automatic start mode.'
        default False
        help
            If enabled, the Openthread Device will create or connect to thread network with pre-configured
            network parameters automatically. Otherwise, user need to configure Thread via CLI command manually.
endmenu

menu "SD SPI Configuration"

    config EXAMPLE_FORMAT_IF_MOUNT_FAILED
        bool "Format the card if mount failed"
        default n
        help
            If this config item is set, format_if_mount_failed will be set to true and the card will be formatted if
            the mount has failed.

    config EXAMPLE_PIN_MOSI
        int "MOSI GPIO number"
        default 15 if IDF_TARGET_ESP32
        default 35 if IDF_TARGET_ESP32S2
        default 35 if IDF_TARGET_ESP32S3
        default 5  if IDF_TARGET_ESP32H2
        default 11 if IDF_TARGET_ESP32P4
        default 4  # C3 and others

    config EXAMPLE_PIN_MISO
        int "MISO GPIO number"
        default 2 if IDF_TARGET_ESP32
        default 37 if IDF_TARGET_ESP32S2
        default 37 if IDF_TARGET_ESP32S3
        default 0  if IDF_TARGET_ESP32H2
        default 13 if IDF_TARGET_ESP32P4
        default 6  # C3 and others

    config EXAMPLE_PIN_CLK
        int "CLK GPIO number"
        default 14 if IDF_TARGET_ESP32
        default 36 if IDF_TARGET_ESP32S2
        default 36 if IDF_TARGET_ESP32S3
        default 4  if IDF_TARGET_ESP32H2
        default 12 if IDF_TARGET_ESP32P4
        default 5  # C3 and others

    config EXAMPLE_PIN_CS
        int "CS GPIO number"
        default 13 if IDF_TARGET_ESP32
        default 34 if IDF_TARGET_ESP32S2
        default 34 if IDF_TARGET_ESP32S3
        default 10 if IDF_TARGET_ESP32P4
        default 1  # C3 and others

endmenu

menu "WiFi sniffer Configuration"

    orsource "$IDF_PATH/examples/common_components/env_caps/$IDF_TARGET/Kconfig.env_caps"

    config SNIFFER_STORE_HISTORY
        bool "Store command history into flash"
        default y
        help
            Linenoise line editing library provides functions to save and load command history.
            If this option is enabled, initalizes a FAT filesystem and uses it to store command history.

    choice SNIFFER_PCAP_DESTINATION
        prompt "Select destination to store pcap file"
        default SNIFFER_PCAP_DESTINATION_SD
        help
            Select where to store the pcap file.
            Currently support storing files to SD card or to host via JTAG interface with 'Trace memory' enabled.
        config SNIFFER_PCAP_DESTINATION_SD
            bool "SD Card"
            help
                Store pcap file to SD card.
        config SNIFFER_PCAP_DESTINATION_JTAG
            bool "JTAG (App Trace)"
            depends on APPTRACE_DEST_TRAX
            help
                Store pcap file to host via JTAG interface.
        config SNIFFER_PCAP_DESTINATION_MEMORY
            bool "Memory"
            help
                Store pcap file to memory.
    endchoice

    if SNIFFER_PCAP_DESTINATION_SD
        choice SNIFFER_SD_MODE
            prompt "Select SD card work mode"
            default SNIFFER_SD_SDMMC_MODE
            help
                Select whitch peripheral SD card should use.
            config SNIFFER_SD_SDMMC_MODE
                bool "SDMMC"
                depends on IDF_TARGET_ESP32 || IDF_TARGET_ESP32S3
                help
                    Use SDMMC mode (Not support on esp32c3).
            config SNIFFER_SD_SPI_MODE
                bool "SPI"
                help
                    Use SPI mode.
        endchoice
        config SNIFFER_MOUNT_POINT
            string "SD card mount point in the filesystem"
            default "/sdcard"
            help
                Specify the mount point in the VFS (Virtual File System) for SD card.

        config SNIFFER_PCAP_FILE_NAME_MAX_LEN
            int "Max name length of pcap file"
            default 32
            help
                Specify maximum name length of pcap file.
    endif

    if SNIFFER_PCAP_DESTINATION_MEMORY
        config SNIFFER_PCAP_MEMORY_SIZE
            int "Memory size of the '.pcap' file in memory"
            default 4096
            help
                Max memory size to storage packet in memory.
    endif

    config SNIFFER_WORK_QUEUE_LEN
        int "Length of sniffer work queue"
        default 128
        help
            The sniffer callback function should not do heavy work, so we put all heavy IO operation to another task.
            The task gets some basic info of sniffer packet via queue.
            Here you should specify the length of queue.

    config SNIFFER_TASK_STACK_SIZE
        int "Stack size of sniffer task"
        default 4096
        help
            Stack size of sniffer task.

    config SNIFFER_TASK_PRIORITY
        int "Priority of sniffer task"
        default 2
        help
            Priority of sniffer task.

endmenu
```

## examples/ESP-IDF/minino/sdkconfig.defaults
```kconfig
# Enable support for power management
CONFIG_PM_ENABLE=y
# Enable tickless idle mode
CONFIG_FREERTOS_USE_TICKLESS_IDLE=y
# Put related source code in IRAM
CONFIG_PM_SLP_IRAM_OPT=y
CONFIG_PM_RTOS_IDLE_OPT=y
# Use 1000Hz freertos tick to lower sleep time threshold
CONFIG_FREERTOS_HZ=1000
# For button power save
CONFIG_GPIO_BUTTON_SUPPORT_POWER_SAVE=y

#
# Bluetooth
#
CONFIG_BT_ENABLED=y
CONFIG_BT_BLUEDROID_ENABLED=y
CONFIG_BT_BLE_42_FEATURES_SUPPORTED=y

# Open Thread Configuration
#
# Partition Table
#
CONFIG_PARTITION_TABLE_CUSTOM=y
CONFIG_PARTITION_TABLE_CUSTOM_FILENAME="partitions.csv"
CONFIG_PARTITION_TABLE_FILENAME="partitions.csv"
CONFIG_PARTITION_TABLE_OFFSET=0x8000
CONFIG_PARTITION_TABLE_MD5=y
# end of Partition Table

#
# mbedTLS
#
CONFIG_MBEDTLS_CMAC_C=y
CONFIG_MBEDTLS_SSL_PROTO_DTLS=y
CONFIG_MBEDTLS_KEY_EXCHANGE_ECJPAKE=y
CONFIG_MBEDTLS_ECJPAKE_C=y
# end of mbedTLS

#
# OpenThread
#
CONFIG_OPENTHREAD_ENABLED=y
CONFIG_OPENTHREAD_BORDER_ROUTER=n
CONFIG_OPENTHREAD_DNS64_CLIENT=y
# end of OpenThread

#
# lwIP
#
CONFIG_LWIP_TCPIP_TASK_STACK_SIZE=4096
CONFIG_LWIP_IPV6_NUM_ADDRESSES=8
CONFIG_LWIP_MULTICAST_PING=y
CONFIG_LWIP_HOOK_IP6_SELECT_SRC_ADDR_CUSTOM=y
# end of lwIP

#
# IEEE 802.15.4
#
CONFIG_IEEE802154_ENABLED=y
CONFIG_IEEE802154_RECEIVE_DONE_HANDLER=y
# end of IEEE 802.15.4

########### WiFi Sniffer config ###########
# Reduce bootloader log verbosity
CONFIG_BOOTLOADER_LOG_LEVEL_WARN=y
CONFIG_BOOTLOADER_LOG_LEVEL=2

# Increase main task stack size
CONFIG_ESP_MAIN_TASK_STACK_SIZE=7168

# Enable filesystem
CONFIG_PARTITION_TABLE_CUSTOM=y
# CONFIG_PARTITION_TABLE_CUSTOM_FILENAME="partitions_example.csv"
# CONFIG_PARTITION_TABLE_FILENAME="partitions_example.csv"

# Enable FreeRTOS stats formatting functions, needed for 'tasks' command
CONFIG_FREERTOS_USE_TRACE_FACILITY=y
CONFIG_FREERTOS_USE_STATS_FORMATTING_FUNCTIONS=y

CONFIG_ESPTOOLPY_FLASHSIZE_4MB=y

# FatFS
CONFIG_FATFS_LFN_HEAP=y
CONFIG_FATFS_MAX_LFN=31

# Network Interfaces
CONFIG_EXAMPLE_USE_INTERNAL_ETHERNET=n
CONFIG_EXAMPLE_USE_SPI_ETHERNET=n
```
