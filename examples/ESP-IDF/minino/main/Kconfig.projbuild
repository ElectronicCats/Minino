## firmware/sdkconfig.defaults
```kconfig
# Enable support for power management
CONFIG_PM_ENABLE=y
# Enable tickless idle mode
CONFIG_FREERTOS_USE_TICKLESS_IDLE=y
# Put related source code in IRAM
CONFIG_PM_SLP_IRAM_OPT=y
CONFIG_PM_RTOS_IDLE_OPT=y
# Use 1000Hz freertos tick to lower sleep time threshold
CONFIG_FREERTOS_HZ=1000
# For button power save
CONFIG_GPIO_BUTTON_SUPPORT_POWER_SAVE=y

#
# Bluetooth
#
CONFIG_BT_ENABLED=y
CONFIG_BT_BLUEDROID_ENABLED=y
CONFIG_BT_BLE_42_FEATURES_SUPPORTED=y

# Open Thread Configuration


#
# mbedTLS
#
CONFIG_MBEDTLS_CMAC_C=y
CONFIG_MBEDTLS_SSL_PROTO_DTLS=y
CONFIG_MBEDTLS_KEY_EXCHANGE_ECJPAKE=y
CONFIG_MBEDTLS_ECJPAKE_C=y
# end of mbedTLS

#
# IEEE 802.15.4
#
CONFIG_IEEE802154_ENABLED=y
CONFIG_IEEE802154_RECEIVE_DONE_HANDLER=y
# end of IEEE 802.15.4

########### WiFi Sniffer config ###########
# Reduce bootloader log verbosity
CONFIG_BOOTLOADER_LOG_LEVEL_WARN=y
CONFIG_BOOTLOADER_LOG_LEVEL=2

# Increase main task stack size
CONFIG_ESP_MAIN_TASK_STACK_SIZE=7168

# Enable FreeRTOS stats formatting functions, needed for 'tasks' command
CONFIG_FREERTOS_USE_TRACE_FACILITY=y
CONFIG_FREERTOS_USE_STATS_FORMATTING_FUNCTIONS=y

CONFIG_ESP_TASK_WDT_CHECK_IDLE_TASK_CPU0=n

#
# Serial flasher config
#
CONFIG_ESPTOOLPY_FLASHSIZE_8MB=y

# FatFS
CONFIG_FATFS_LFN_HEAP=y
CONFIG_FATFS_MAX_LFN=31

# Network Interfaces
CONFIG_EXAMPLE_USE_INTERNAL_ETHERNET=n
CONFIG_EXAMPLE_USE_SPI_ETHERNET=n

#
# Zboss
#
CONFIG_ZB_ENABLED=y
CONFIG_ZB_ZCZR=y
# end of Zboss
# end of Component config

#
# Log output
#
CONFIG_LOG_MASTER_LEVEL=y
# end of Log output

#
# ESP Console
#
CONFIG_ESP_CONSOLE_USB_SERIAL_JTAG=y
CONFIG_ESP_CONSOLE_USB_SERIAL_JTAG_ENABLED=y


#
# Enabled Features
#
## WIFI ##
CONFIG_WIFI_APPS_ENABLE=y
CONFIG_WIFI_APP_ANALYZER=y
CONFIG_WIFI_APP_DEAUTH=y
CONFIG_WIFI_APP_DOS=y
## BLUETOOTH ##
CONFIG_BLUETOOTH_APPS_ENABLE=y
CONFIG_BLUETOOTH_APP_TRAKERS=y
CONFIG_BLUETOOTH_APP_SPAM=y
## ZIGBEE ##
CONFIG_ZIGBEE_APPS_ENABLE=y
CONFIG_ZIGBEE_APP_SPOOFING=y
CONFIG_ZIGBEE_APP_SNIFFER=y
## THREAD ##
CONFIG_THREAD_APPS_ENABLE=y
CONFIG_THREAD_APP_BROADCAST=y
CONFIG_THREAD_APP_SNIFFER=y
## GPS ##
CONFIG_GPS_APPS_ENABLE=y
CONFIG_GPS_APP_WARDRIVING=y
## OTA ##
CONFIG_OTA_ENABLE=y
## FILE MANAGER ##
CONFIG_FILE_MANAGER_ENABLE=y
CONFIG_FILE_MANAGER_LOCAL=y
CONFIG_FILE_MANAGER_WEB=y

#
# Partition Table
#
CONFIG_OPENTHREAD_ENABLED=y
CONFIG_PARTITION_TABLE_CUSTOM=y
CONFIG_PARTITION_TABLE_CUSTOM_FILENAME="partitions.csv"
CONFIG_PARTITION_TABLE_FILENAME="partitions.csv"
CONFIG_PARTITION_TABLE_OFFSET=0x8000
CONFIG_PARTITION_TABLE_MD5=y
# end of Partition Table
```

## firmware_refactor/sdkconfig.defaults
```kconfig
# Set target
CONFIG_IDF_TARGET="esp32c6"

# Set the target size
CONFIG_ESPTOOLPY_FLASHSIZE_8MB=y
CONFIG_ESPTOOLPY_FLASHSIZE="8MB"

# Configurate the watch dog timer
CONFIG_ESP_SYSTEM_WDT=n
CONFIG_ESP_TASK_WDT_CHECK_IDLE_TASK_CPU0=n
```
