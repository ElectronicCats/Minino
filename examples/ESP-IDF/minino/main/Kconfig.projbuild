## firmware/components/minino_config/Kconfig.projbuild
```kconfig
menu "General project"

	choice BOARD_TYPE
		prompt "Board type"
		help
			Select Board type.
		config BOARD_MININO
			bool "MININO"
			help
				MININO Board.
		config BOARD_BSIDES
			bool "Badge BSides"
			help
				Badge BSides.
		config BOARD_DRAGONJAR
			bool "Badge DragonJar"
			help
				Badge DragonJar.
		config BOARD_EKOPARTY
			bool "Badge EkoParty"
			help
				Badge EkoParty.
		config BOARD_BUGCON
			bool "Badge BugCon"
			help
				Badge BugCon.
		config BOARD_BSSEATTLE
			bool "Badge BSides Seattle"
			help
				Badge BSides Seattle.
	endchoice

	config PROJECT_VERSION
		string "Firmware version"
		default "1.1.0.0"
		help
			Firmware version.
	
	menu "WiFi Captive Portal Config"
		config WIFI_AP_NAME
		string "WIFI Ap Name"
		default "MININO_AP"
		help
			Minino Access Point Name
		
		config WIFI_AP_PASSWORD
		string "WIFI Ap Password"
		default ""
		help
			Minino Access Point Password
		
		config WIFI_AP_IP
		string "WIFI Ap IP"
		default "192.168.0.1"
		help
			Minino Access Point IP
	
		config WIFI_AP_GATEWAY
		string "WIFI Ap GATEWAY"
		default "192.168.0.1"
		help
			Minino Access Point GATEWAY

		config WIFI_AP_NETMASK
		string "WIFI Ap NETMASK"
		default "255.255.255.0"
		help
			Minino Access Point NETMASK

	endmenu

	menu "Debug"

		menu "Modules"

			config CMD_UART_BRIDGE_DEBUG
				bool "CMD UART Bridge debug"
				default false
				help
					Enable CMD UART Bridge debug.

			config CONFIGURATION_DEBUG
				bool "Configuration debug"
				default false
				help
					Enable Configuration debug.

			config BLE_MODULE_DEBUG
				bool "BLE module debug"
				default false
				help
					Enable BLE module debug.

			config CAT_CONSOLE_DEBUG
				bool "Cat console debug"
				default false
				help
					Enable Cat console debug.

			config CATDOS_MODULE_DEBUG
				bool "Cat DOS module debug"
				default false
				help
					Enable Cat DOS module debug.

			config GPS_MODULE_DEBUG
				bool "GPS module debug"
				default false
				help
					Enable GPS module debug.

			config KEYBOARD_DEBUG
				bool "Keyboard debug"
				default false
				help
					Enable Keyboard debug.

			config MAIN_DEBUG
				bool "Main debug"
				default false
				help
					Enable Main debug.

			config MENU_SCREENS_DEBUG
				bool "Menu screens module debug"
				default false
				help
					Enable Menu screens module debug.

			config OLED_DRIVER_DEBUG
				bool "OLED driver debug"
				default false
				help
					Enable OLED driver debug.

			config OLED_MODULE_DEBUG
				bool "OLED module debug"
				default false
				help
					Enable OLED module debug.

			config OPEN_THREAD_MODULE_DEBUG
				bool "OpenThread module debug"
				default false
				help
					Enable OpenThread module debug.

			config SETTINGS_MODULE_DEBUG
				bool "Settings module debug"
				default false
				help
					Enable Settings module debug.

			config WARDRIVING_MODULE_DEBUG
				bool "Wardriving module debug"
				default false
				help
					Enable Wardriving module debug.

			config WEB_FILE_BROWSER_DEBUG
				bool "Web file browser debug"
				default false
				help
					Enable Web file browser debug.

			config WIFI_MODULE_DEBUG
				bool "WiFi module debug"
				default false
				help
					Enable WiFi module debug.

			config ZIGBEE_MODULE_DEBUG
				bool "Zigbee module debug"
				default false
				help
					Enable Zigbee module debug.

		endmenu

			menu "Components"

				config BT_GATTC_DEBUG
					bool "BT GATTC debug"
					default false
					help
						Enable BT GATTC debug.

				config BT_GATTS_DEBUG
					bool "BT GATTS debug"
					default false
					help
						Enable BT GATTS debug.

				config BT_SPAM_APP_DEBUG
					bool "BT Spam app debug"
					default false
					help
						Enable BT Spam app debug.

				config CAPTIVE_PORTAL_DEBUG
					bool "Captive Portal debug"
					default false
					help
						Enable Captive Portal debug.

				config CMD_SNIFFER_DEBUG
					bool "CMD Sniffer debug"
					default false
					help
						Enable CMD Sniffer debug.

				config CMD_PCAP_DEBUG
					bool "CMD PCAP debug"
					default false
					help
						Enable CMD PCAP debug.

				config CMD_WIFI_DEBUG
					bool "CMD WiFi debug"
					default false
					help
						Enable CMD WiFi debug.

				config DNS_SERVER_DEBUG
					bool "DNS Server debug"
					default false
					help
						Enable DNS Server debug.

				config IEEE_SNIFFER_DEBUG
					bool "IEEE Sniffer debug"
					default false
					help
						Enable IEEE Sniffer debug.

				config LEDC_CONTROLLER_DEBUG
					bool "LEDC Controller debug"
					default false
					help
						Enable LEDC Controller debug.

				config NMEA_PARSER_DEBUG
					bool "NMEA Parser debug"
					default false
					help
						Enable NMEA Parser debug.

				config OPEN_THREAD_DEBUG
					bool "Open Thread debug"
					default false
					help
						Enable Open Thread debug.

				config PREFERENCES_DEBUG
					bool "Preferences debug"
					default false
					help
						Enable Preferences debug.

				config SD_CARD_DEBUG
					bool "SD Card debug"
					default false
					help
						Enable SD Card debug.

				config TRACKERS_SCANNER_DEBUG
					bool "Trackers Scanner debug"
					default false
					help
						Enable Trackers Scanner debug.

				config UART_BRIDGE_DEBUG
					bool "UART Bridge debug"
					default false
					help
						Enable UART Bridge debug.

				config WIFI_ATTACKS_DEBUG
					bool "WiFi Attacks debug"
					default false
					help
						Enable WiFi Attacks debug.

				config WIFI_CONTROLLER_DEBUG
					bool "WiFi Controller debug"
					default false
					help
						Enable WiFi Controller debug.

				config WIFI_SCANNER_DEBUG
					bool "WiFi Scanner debug"
					default false
					help
						Enable WiFi Scanner debug.

				config WIFI_SNIFFER_DEBUG
					bool "WiFi Sniffer debug"
					default false
					help
						Enable WiFi Sniffer debug.

				config ZIGBEE_SWITCH_DEBUG
					bool "Zigbee Switch debug"
					default false
					help
						Enable Zigbee Switch debug.

			endmenu

	endmenu

	menu "GPS Configuration"

    orsource "$IDF_PATH/examples/common_components/env_caps/$IDF_TARGET/Kconfig.env_caps"

    config NMEA_PARSER_UART_RXD
        int "UART RXD pin number"
        range ENV_GPIO_RANGE_MIN ENV_GPIO_IN_RANGE_MAX
        default 4
        help
            GPIO number for UART RX pin. See UART documentation for more information
            about available pin numbers for UART.

    config NMEA_PARSER_UART_TXD
        int "UART TXD pin number"
        range ENV_GPIO_RANGE_MIN ENV_GPIO_OUT_RANGE_MAX
        default 5
        help
            GPIO number for UART TX pin. See UART documentation for more information
            about available pin numbers for UART.

    config NMEA_PARSE_UART_BAUDRATE
        int "UART Baudrate"
        range 0 115200
        default 115200
        help
            Baudrate of UART.

    config NMEA_PARSER_RING_BUFFER_SIZE
        int "NMEA Parser Ring Buffer Size"
        range 0 8192
        default 2048
        help
            Size of the ring buffer used for UART Rx channel.
            For ATGM336H-6N-74: Use 2048 for 1Hz, 4096 for 5Hz, 8192 for 10Hz update rate.

    config NMEA_PARSER_TASK_STACK_SIZE
        int "NMEA Parser Task Stack Size"
        range 0 8192
        default 4096
        help
            Stack size of NMEA Parser task.
            For ATGM336H-6N-74 with multi-constellation: Recommended 4096-6144.

    config NMEA_PARSER_TASK_PRIORITY
        int "NMEA Parser Task Priority"
        range 0 24
        default 3
        help
            Priority of NMEA Parser task.
            For ATGM336H-6N-74: Higher priority (3-4) improves fix time and accuracy.

    	menu "NMEA Statement Support"
        comment "At least one statement must be selected"
        config NMEA_STATEMENT_GGA
            bool "GGA Statement"
            default y
            help
                Enabling this option will parse the following parameter from GGA statement:

                - Latitude, Longitude, Altitude;
                - Number of satellites in use, fix status (no fix, GPS, DGPS), UTC time;

        config NMEA_STATEMENT_GSA
            bool "GSA Statement"
            default y
            help
                Enabling this option will parse the following parameter from GSA statement:

                - Position/Vertical/Horizontal dilution of precision;
                - Fix mode (no fix, 2D, 3D fix);
                - IDs of satellites in use;

        config NMEA_STATEMENT_GSV
            bool "GSV Statement"
            default y
            help
                Enabling this option will parse the following parameter from GSV statement:

                - Number of satellites in view;
                - Optional details of each satellite in view;

        config NMEA_STATEMENT_RMC
            bool "RMC Statement"
            default y
            help
                Enabling this option will parse the following parameter from RMC statement:

                - Validity of GPS signal;
                - Ground speed (knots) and course over ground (degrees);
                - Magnetic variation;
                - UTC date;

        config NMEA_STATEMENT_GLL
            bool "GLL Statement"
            default y
            help
                Enabling this option will parse the following parameter from GLL statement:

                - Latitude, Longitude;
                - UTC time;

        config NMEA_STATEMENT_VTG
            bool "VTG Statement"
            default y
            help
                Enabling this option will parse the following parameter from VTG statement:

                - Ground speed (knots, km/h) and course over ground (degrees);
                - Magnetic variation;

    endmenu

	endmenu

	menu "OLED Screen Configuration"

		config GPIO_RANGE_MAX
			int
			default 33 if IDF_TARGET_ESP32
			default 46 if IDF_TARGET_ESP32S2
			default 48 if IDF_TARGET_ESP32S3
			default 18 if IDF_TARGET_ESP32C2
			default 19 if IDF_TARGET_ESP32C3
			default 30 if IDF_TARGET_ESP32C6

		choice INTERFACE
			prompt "Interface"
			default I2C_INTERFACE
			help
				Select Interface.
			config I2C_INTERFACE
				bool "I2C Interface"
				help
					I2C Interface.
			config SPI_INTERFACE
				bool "SPI Interface"
				help
					SPI Interface.
		endchoice

		choice DRIVER
			prompt "Driver"
			default SH1106 if BOARD_MININO
			default SSD1306 if !BOARD_MININO
			help
				Select Driver.
			config SSD1306
				bool "SSD1306"
				help
					SSD1306 Driver.
			config SH1106
				bool "SH1106"
				help
					SH1106 Driver.
		endchoice

		choice RESOLUTION
			prompt "Panel resolution"
			default RESOLUTION_128X64 if BOARD_MININO
			default RESOLUTION_128X64 if BOARD_BSSEATTLE
			default RESOLUTION_128X32 if !BOARD_MININO
			help
				Select Panel resolution.
			config RESOLUTION_128X32
				bool "128x32 Panel"
				help
					Panel is 128x32.
			config RESOLUTION_128X64
				bool "128x64 Panel"
				help
					Panel is 128x64.
		endchoice

		config FLIP
			bool "Flip upside down"
			default false
			help
				Flip upside down.

		config SCL_GPIO
			depends on I2C_INTERFACE
			int "SCL GPIO number"
			range 0 GPIO_RANGE_MAX
			default 22 if IDF_TARGET_ESP32
			default 12 if IDF_TARGET_ESP32S2
			default 12 if IDF_TARGET_ESP32S3
			default 7 if IDF_TARGET_ESP32C6
			default  6 # C3 and others
			help
				GPIO number (IOxx) to I2C SCL.
				Some GPIOs are used for other purposes (flash connections, etc.) and cannot be used to I2C.
				GPIOs 35-39 are input-only so cannot be used as outputs.

		config SDA_GPIO
			depends on I2C_INTERFACE
			int "SDA GPIO number"
			range 0 GPIO_RANGE_MAX
			default 21 if IDF_TARGET_ESP32
			default 11 if IDF_TARGET_ESP32S2
			default 11 if IDF_TARGET_ESP32S3
			default 6 if IDF_TARGET_ESP32C6
			default  5 # C3 and others
			help
				GPIO number (IOxx) to I2C SDA.
				Some GPIOs are used for other purposes (flash connections, etc.) and cannot be used to I2C.
				GPIOs 35-39 are input-only so cannot be used as outputs.

		config MOSI_GPIO
			depends on SPI_INTERFACE
			int "MOSI GPIO number"
			range 0 GPIO_RANGE_MAX
			default 23 if IDF_TARGET_ESP32
			default 35 if IDF_TARGET_ESP32S2
			default 35 if IDF_TARGET_ESP32S3
			default  1 # C3 and others
			help
				GPIO number (IOxx) to SPI MOSI.
				Some GPIOs are used for other purposes (flash connections, etc.) and cannot be used to MOSI.
				On the ESP32, GPIOs 35-39 are input-only so cannot be used as outputs.
				On the ESP32-S2, GPIO 46 is input-only so cannot be used as outputs.

		config SCLK_GPIO
			depends on SPI_INTERFACE
			int "SCLK GPIO number"
			range 0 GPIO_RANGE_MAX
			default 18 if IDF_TARGET_ESP32
			default 36 if IDF_TARGET_ESP32S2
			default 36 if IDF_TARGET_ESP32S3
			default  2 # C3 and others
			help
				GPIO number (IOxx) to SPI SCLK.
				Some GPIOs are used for other purposes (flash connections, etc.) and cannot be used to SCLK.
				On the ESP32, GPIOs 35-39 are input-only so cannot be used as outputs.
				On the ESP32-S2, GPIO 46 is input-only so cannot be used as outputs.

		config CS_GPIO
			depends on SPI_INTERFACE
			int "CS GPIO number"
			range 0 GPIO_RANGE_MAX
			default  5 if IDF_TARGET_ESP32
			default 34 if IDF_TARGET_ESP32S2
			default 34 if IDF_TARGET_ESP32S3
			default 10 # C3 and others
			help
				GPIO number (IOxx) to SPI CS.
				Some GPIOs are used for other purposes (flash connections, etc.) and cannot be used to CS.
				GPIOs 35-39 are input-only so cannot be used as outputs.

		config DC_GPIO
			depends on SPI_INTERFACE
			int "DC GPIO number"
			range 0 GPIO_RANGE_MAX
			default  4 if IDF_TARGET_ESP32
			default 37 if IDF_TARGET_ESP32S2
			default 37 if IDF_TARGET_ESP32S3
			default  3 # C3 and others
			help
				GPIO number (IOxx) to SPI DC.
				Some GPIOs are used for other purposes (flash connections, etc.) and cannot be used to DC.
				GPIOs 35-39 are input-only so cannot be used as outputs.

		config RESET_GPIO
			int "RESET GPIO number"
			range -1 GPIO_RANGE_MAX
			default 15 if IDF_TARGET_ESP32
			default 38 if IDF_TARGET_ESP32S2
			default 38 if IDF_TARGET_ESP32S3
			default -1 if IDF_TARGET_ESP32C6
			default  4 # C3 and others
			help
				GPIO number (IOxx) to RESET.
				When it is -1, RESET isn't performed.
				Some GPIOs are used for other purposes (flash connections, etc.) and cannot be used to RESET.
				GPIOs 35-39 are input-only so cannot be used as outputs.

		choice I2C_PORT
			depends on I2C_INTERFACE
			prompt "I2C port that controls this bus"
			default I2C_PORT_0
			help
				Select I2C port that controls this bus.
			config I2C_PORT_0
				bool "I2C_PORT_0"
				help
					Use I2C_PORT_0.
			config I2C_PORT_1
				depends on IDF_TARGET_ESP32 || IDF_TARGET_ESP32S2 || IDF_TARGET_ESP32S3
				bool "I2C_PORT_1"
				help
					Use I2C_PORT_1.
		endchoice

		choice SPI_HOST
			depends on SPI_INTERFACE
			prompt "SPI peripheral that controls this bus"
			default SPI2_HOST
			help
				Select SPI peripheral that controls this bus.
			config SPI2_HOST
				bool "SPI2_HOST"
				help
					Use SPI2_HOST. This is also called HSPI_HOST.
			config SPI3_HOST
				depends on IDF_TARGET_ESP32 || IDF_TARGET_ESP32S2 || IDF_TARGET_ESP32S3
				bool "SPI3_HOST"
				help
					USE SPI3_HOST. This is also called VSPI_HOST
		endchoice

	endmenu

	menu "Keyboard Configuration"

		config GPIO_RANGE_MAX
			int
			default 33 if IDF_TARGET_ESP32
			default 46 if IDF_TARGET_ESP32S2
			default 48 if IDF_TARGET_ESP32S3
			default 18 if IDF_TARGET_ESP32C2
			default 19 if IDF_TARGET_ESP32C3
			default 30 if IDF_TARGET_ESP32C6
			default 27 if IDF_TARGET_ESP32H2
		config BOOT_BUTTON
			int "GPIO BOOT Button Pin"
			range 0 GPIO_RANGE_MAX
			default 9 if IDF_TARGET_ESP32C6
			help
				Select the GPIO pin number for the BOOT button.
		config GPIO_LEFT_BUTTON
			int "GPIO LEFT Button Pin"
			range 0 GPIO_RANGE_MAX
			default 22 if BOARD_MININO
			default 22 if BOARD_BSSEATTLE
			default 1 if BOARD_BSIDES
			default 5 if BOARD_DRAGONJAR
			default 1 if BOARD_EKOPARTY
			default 18 if BOARD_BUGCON
			help
				Select the GPIO pin number for the LEFT button.
		config GPIO_RIGHT_BUTTON
			int "GPIO RIGHT Button Pin"
			range 0 GPIO_RANGE_MAX
			default 1 if BOARD_MININO
			default 1 if BOARD_BSSEATTLE
			default 15 if BOARD_BSIDES
			default 10 if BOARD_DRAGONJAR
			default 15 if BOARD_EKOPARTY
			default 23 if BOARD_BUGCON
			help
				Select the GPIO pin number for the RIGHT button.
		config GPIO_UP_BUTTON
			int "GPIO UP Button Pin"
			range 0 GPIO_RANGE_MAX
			default 15 if BOARD_MININO
			default 15 if BOARD_BSSEATTLE
			default 22 if BOARD_BSIDES
			default 0 if BOARD_DRAGONJAR
			default 22 if BOARD_EKOPARTY
			default 21 if BOARD_BUGCON
			help
				Select the GPIO pin number for the UP button.
		config GPIO_DOWN_BUTTON
			int "GPIO DOWN Button Pin"
			range 0 GPIO_RANGE_MAX
			default 23 if BOARD_MININO
			default 23 if BOARD_BSSEATTLE
			default 23 if BOARD_BSIDES
			default 1 if BOARD_DRAGONJAR
			default 23 if BOARD_EKOPARTY
			default 22 if BOARD_BUGCON
			help
				Select the GPIO pin number for the DOWN button.
	endmenu

	menu "Enable Apps & Features"

		menu "Hardware components"
			################################# GPS ###################################
			menu "GPS"	
				config GPS_ENABLED
					bool "Enable GPS"
					default y if BOARD_MININO
    				default n if !BOARD_MININO
					help
						Enable GPS.
			endmenu
			################################# SD ###################################
			menu "SD"	
				config SD_ENABLED
					bool "Enable SD"
					default y if BOARD_MININO
    				default n if !BOARD_MININO
					help
						Enable SD.
			endmenu
			################################# LEDs ###################################
			menu "LEDs"
				config LEDS_COMPONENT_ENABLED
					bool "Enable LEDs component"
					default y if BOARD_MININO
					default n if !BOARD_MININO
					help
						Enable the LEDs component.
			endmenu
			################################# Buzzer ###################################
			menu "Buzzer"
				config BUZZER_COMPONENT_ENABLED
					bool "Enable buzzer component"
					default y if BOARD_MININO
					default n if BOARD_BSIDES
					default n if BOARD_DRAGONJAR
					default y if BOARD_EKOPARTY
					default n if BOARD_BUGCON
					default n if BOARD_BSSEATTLE
					help
						Enable the buzzer component.
				config BUZZER_PIN
					int "Buzzer GPIO Pin"
					range -1 GPIO_RANGE_MAX
					default 2 if BOARD_MININO
					default -1 if BOARD_BSIDES
					default -1 if BOARD_DRAGONJAR
					default 11 if BOARD_EKOPARTY
					default -1 if BOARD_BUGCON
					default -1 if BOARD_BSSEATTLE
					help
						Select the GPIO pin number for the Buzzer.
			endmenu
		endmenu

		menu "Apps"

			################################# WIFI ###################################
			config WIFI_APPS_ENABLE
					bool "Enable WiFi Apps"
					default y
					help
						Enable or disable all WiFi applications.

			############################### BLUETOOTH #################################

			config BLUETOOTH_APPS_ENABLE
					bool "Enable Bluetooth Apps"
					default y
					help
						Enable or disable all Bluetooth applications.

			################################# ZIGBEE ###################################

			config ZIGBEE_APPS_ENABLE
					bool "Enable Zigbee Apps"
					default y
					help
						Enable or disable all Zigbee applications.

			################################# THREAD ###################################

			config THREAD_APPS_ENABLE
					bool "Enable Thread Apps"
					default y
					help
						Enable or disable all Thread applications.

			################################# GPS ###################################

			config GPS_APPS_ENABLE
					bool "Enable GPS Apps"
					default y
					help
						Enable or disable all GPS applications.

			################################# GPIO ###################################

			config GPIO_APPS_ENABLE
					bool "Enable GPIO Apps"
					default y
					help
						Enable or disable all GPIO applications.

			################################# OTA ###################################

			config OTA_ENABLE
					bool "Enable OTA feature"
					default y if BOARD_MININO
    				default n if !BOARD_MININO
					help
						Enable or disable OTA feature.

			########################### FILE MANAGER #############################

			config FILE_MANAGER_ENABLE
					bool "Enable File Manager Features"
					default y
					help
						Enable or disable all File Manager Features.

			if FILE_MANAGER_ENABLE

			config FILE_MANAGER_LOCAL
					bool "Enable Local File Manager"
					default y
					help
						Enable or disable the Local File Manager feature.

			config FILE_MANAGER_WEB
					bool "Enable Web File Manager"
					default y
					help
						Enable or disable the Web File Manager Feature.
			endif # FILE_MANAGER_ENABLE

			########################### Screen Savers ############################

			menu "Screen Saver"
				config SCREEN_SAVER_LETTERS
						bool "Letters"
						default y
				config SCREEN_SAVER_FACE
						bool "Face"
						default y
				config SCREEN_SAVER_PWNLABS
						bool "PwnLabs"
						default y
				config SCREEN_SAVER_EC
						bool "EC"
						default y
				config SCREEN_SAVER_MINI_FACE
						bool "Mini Face"
						default y
				config SCREEN_SAVER_BABY_DRAGON
						bool "Baby Dragon"
						default y									
			endmenu

		endmenu
	
	endmenu

endmenu
```
