## firmware/main/Kconfig.projbuild
```kconfig
menu "General project"

	choice BOARD_TYPE
		prompt "Board type"
		default BOARD_MININO
		help
			Select Board type.
		config BOARD_MININO
			bool "MININO"
			help
				MININO Board.
		config BOARD_BADGE
			bool "Badge"
			help
				Badge Board.
	endchoice

	config PROJECT_VERSION
		string "Firmware version"
		default "1.1.0.0"
		help
			Firmware version.

	menu "Modules debug configuration"

		config MAIN_DEBUG
			bool "Main debug"
			default false
			help
				Enable Main debug.

		config CONFIGURATION_DEBUG
			bool "Configuration debug"
			default false
			help
				Enable Configuration debug.

		config BLE_MODULE_DEBUG
			bool "BLE module debug"
			default false
			help
				Enable BLE module debug.

		config CAT_CONSOLE_DEBUG
			bool "Cat console debug"
			default false
			help
				Enable Cat console debug.

		config CATDOS_MODULE_DEBUG
			bool "Cat DOS module debug"
			default false
			help
				Enable Cat DOS module debug.

		config GPS_MODULE_DEBUG
			bool "GPS module debug"
			default false
			help
				Enable GPS module debug.

		config KEYBOARD_DEBUG
			bool "Keyboard debug"
			default false
			help
				Enable Keyboard debug.

		config MENU_SCREENS_DEBUG
			bool "Menu screens module debug"
			default false
			help
				Enable Menu screens module debug.

		config OLED_DRIVER_DEBUG
			bool "OLED driver debug"
			default false
			help
				Enable OLED driver debug.

		config OLED_MODULE_DEBUG
			bool "OLED module debug"
			default false
			help
				Enable OLED module debug.

		config OPEN_THREAD_MODULE_DEBUG
			bool "OpenThread module debug"
			default false
			help
				Enable OpenThread module debug.

		config SETTINGS_MODULE_DEBUG
			bool "Settings module debug"
			default false
			help
				Enable Settings module debug.

		config WARDRIVING_MODULE_DEBUG
			bool "Wardriving module debug"
			default false
			help
				Enable Wardriving module debug.

		config WEB_FILE_BROWSER_DEBUG
			bool "Web file browser debug"
			default false
			help
				Enable Web file browser debug.

		config WIFI_MODULE_DEBUG
			bool "WiFi module debug"
			default false
			help
				Enable WiFi module debug.

		config ZIGBEE_MODULE_DEBUG
			bool "Zigbee module debug"
			default false
			help
				Enable Zigbee module debug.

	endmenu

	menu "Components debug configuration"

		config BT_GATTC_DEBUG
			bool "BT GATTC debug"
			default false
			help
				Enable BT GATTC debug.

		config BT_GATTS_DEBUG
			bool "BT GATTS debug"
			default false
			help
				Enable BT GATTS debug.

		config BT_SPAM_APP_DEBUG
			bool "BT Spam app debug"
			default false
			help
				Enable BT Spam app debug.

		config CMD_WIFI_DEBUG
			bool "CMD WiFi debug"
			default false
			help
				Enable CMD WiFi debug.

		config DNS_SERVER_DEBUG
			bool "DNS Server debug"
			default false
			help
				Enable DNS Server debug.

		config IEEE_SNIFFER_DEBUG
			bool "IEEE Sniffer debug"
			default false
			help
				Enable IEEE Sniffer debug.

		config LEDC_CONTROLLER_DEBUG
			bool "LEDC Controller debug"
			default false
			help
				Enable LEDC Controller debug.

		config NMEA_PARSER_DEBUG
			bool "NMEA Parser debug"
			default false
			help
				Enable NMEA Parser debug.

		config OPEN_THREAD_DEBUG
			bool "Open Thread debug"
			default false
			help
				Enable Open Thread debug.

		config PREFERENCES_DEBUG
			bool "Preferences debug"
			default false
			help
				Enable Preferences debug.

		config SD_CARD_DEBUG
			bool "SD Card debug"
			default false
			help
				Enable SD Card debug.

		config TRACKERS_SCANNER_DEBUG
			bool "Trackers Scanner debug"
			default false
			help
				Enable Trackers Scanner debug.

		config WIFI_ATTACKS_DEBUG
			bool "WiFi Attacks debug"
			default false
			help
				Enable WiFi Attacks debug.

		config CAPTIVE_PORTAL_DEBUG
			bool "Captive Portal debug"
			default false
			help
				Enable Captive Portal debug.

		config WIFI_CONTROLLER_DEBUG
			bool "WiFi Controller debug"
			default false
			help
				Enable WiFi Controller debug.

		config WIFI_SCANNER_DEBUG
			bool "WiFi Scanner debug"
			default false
			help
				Enable WiFi Scanner debug.

		config CMD_PCAP_DEBUG
			bool "CMD PCAP debug"
			default false
			help
				Enable CMD PCAP debug.

		config CMD_SNIFFER_DEBUG
			bool "CMD Sniffer debug"
			default false
			help
				Enable CMD Sniffer debug.

		config WIFI_SNIFFER_DEBUG
			bool "WiFi Sniffer debug"
			default false
			help
				Enable WiFi Sniffer debug.

		config ZIGBEE_SWITCH_DEBUG
			bool "Zigbee Switch debug"
			default false
			help
				Enable Zigbee Switch debug.

	endmenu

endmenu

menu "OLED Screen Configuration"

	config GPIO_RANGE_MAX
		int
		default 33 if IDF_TARGET_ESP32
		default 46 if IDF_TARGET_ESP32S2
		default 48 if IDF_TARGET_ESP32S3
		default 18 if IDF_TARGET_ESP32C2
		default 19 if IDF_TARGET_ESP32C3
		default 30 if IDF_TARGET_ESP32C6

	choice INTERFACE
		prompt "Interface"
		default I2C_INTERFACE
		help
			Select Interface.
		config I2C_INTERFACE
			bool "I2C Interface"
			help
				I2C Interface.
		config SPI_INTERFACE
			bool "SPI Interface"
			help
				SPI Interface.
	endchoice

	choice DRIVER
		prompt "Driver"
		default SSD1306 if BOARD_BADGE
		default SH1106 if BOARD_MININO
		help
			Select Driver.
		config SSD1306
			bool "SSD1306"
			help
				SSD1306 Driver.
		config SH1106
			bool "SH1106"
			help
				SH1106 Driver.
	endchoice

	choice RESOLUTION
		prompt "Panel resolution"
		default RESOLUTION_128X32 if BOARD_BADGE
		default RESOLUTION_128X64 if BOARD_MININO
		help
			Select Panel resolution.
		config RESOLUTION_128X32
			bool "128x32 Panel"
			help
				Panel is 128x32.
		config RESOLUTION_128X64
			bool "128x64 Panel"
			help
				Panel is 128x64.
	endchoice

	config FLIP
		bool "Flip upside down"
		default false
		help
			Flip upside down.

	config SCL_GPIO
		depends on I2C_INTERFACE
		int "SCL GPIO number"
		range 0 GPIO_RANGE_MAX
		default 22 if IDF_TARGET_ESP32
		default 12 if IDF_TARGET_ESP32S2
		default 12 if IDF_TARGET_ESP32S3
		default 7 if IDF_TARGET_ESP32C6
		default  6 # C3 and others
		help
			GPIO number (IOxx) to I2C SCL.
			Some GPIOs are used for other purposes (flash connections, etc.) and cannot be used to I2C.
			GPIOs 35-39 are input-only so cannot be used as outputs.

	config SDA_GPIO
		depends on I2C_INTERFACE
		int "SDA GPIO number"
		range 0 GPIO_RANGE_MAX
		default 21 if IDF_TARGET_ESP32
		default 11 if IDF_TARGET_ESP32S2
		default 11 if IDF_TARGET_ESP32S3
		default 6 if IDF_TARGET_ESP32C6
		default  5 # C3 and others
		help
			GPIO number (IOxx) to I2C SDA.
			Some GPIOs are used for other purposes (flash connections, etc.) and cannot be used to I2C.
			GPIOs 35-39 are input-only so cannot be used as outputs.

	config MOSI_GPIO
		depends on SPI_INTERFACE
		int "MOSI GPIO number"
		range 0 GPIO_RANGE_MAX
		default 23 if IDF_TARGET_ESP32
		default 35 if IDF_TARGET_ESP32S2
		default 35 if IDF_TARGET_ESP32S3
		default  1 # C3 and others
		help
			GPIO number (IOxx) to SPI MOSI.
			Some GPIOs are used for other purposes (flash connections, etc.) and cannot be used to MOSI.
			On the ESP32, GPIOs 35-39 are input-only so cannot be used as outputs.
			On the ESP32-S2, GPIO 46 is input-only so cannot be used as outputs.

	config SCLK_GPIO
		depends on SPI_INTERFACE
		int "SCLK GPIO number"
		range 0 GPIO_RANGE_MAX
		default 18 if IDF_TARGET_ESP32
		default 36 if IDF_TARGET_ESP32S2
		default 36 if IDF_TARGET_ESP32S3
		default  2 # C3 and others
		help
			GPIO number (IOxx) to SPI SCLK.
			Some GPIOs are used for other purposes (flash connections, etc.) and cannot be used to SCLK.
			On the ESP32, GPIOs 35-39 are input-only so cannot be used as outputs.
			On the ESP32-S2, GPIO 46 is input-only so cannot be used as outputs.

	config CS_GPIO
		depends on SPI_INTERFACE
		int "CS GPIO number"
		range 0 GPIO_RANGE_MAX
		default  5 if IDF_TARGET_ESP32
		default 34 if IDF_TARGET_ESP32S2
		default 34 if IDF_TARGET_ESP32S3
		default 10 # C3 and others
		help
			GPIO number (IOxx) to SPI CS.
			Some GPIOs are used for other purposes (flash connections, etc.) and cannot be used to CS.
			GPIOs 35-39 are input-only so cannot be used as outputs.

	config DC_GPIO
		depends on SPI_INTERFACE
		int "DC GPIO number"
		range 0 GPIO_RANGE_MAX
		default  4 if IDF_TARGET_ESP32
		default 37 if IDF_TARGET_ESP32S2
		default 37 if IDF_TARGET_ESP32S3
		default  3 # C3 and others
		help
			GPIO number (IOxx) to SPI DC.
			Some GPIOs are used for other purposes (flash connections, etc.) and cannot be used to DC.
			GPIOs 35-39 are input-only so cannot be used as outputs.

	config RESET_GPIO
		int "RESET GPIO number"
		range -1 GPIO_RANGE_MAX
		default 15 if IDF_TARGET_ESP32
		default 38 if IDF_TARGET_ESP32S2
		default 38 if IDF_TARGET_ESP32S3
		default -1 if IDF_TARGET_ESP32C6
		default  4 # C3 and others
		help
			GPIO number (IOxx) to RESET.
			When it is -1, RESET isn't performed.
			Some GPIOs are used for other purposes (flash connections, etc.) and cannot be used to RESET.
			GPIOs 35-39 are input-only so cannot be used as outputs.

	choice I2C_PORT
		depends on I2C_INTERFACE
		prompt "I2C port that controls this bus"
		default I2C_PORT_0
		help
			Select I2C port that controls this bus.
		config I2C_PORT_0
			bool "I2C_PORT_0"
			help
				Use I2C_PORT_0.
		config I2C_PORT_1
			depends on IDF_TARGET_ESP32 || IDF_TARGET_ESP32S2 || IDF_TARGET_ESP32S3
			bool "I2C_PORT_1"
			help
				Use I2C_PORT_1.
	endchoice

	choice SPI_HOST
		depends on SPI_INTERFACE
		prompt "SPI peripheral that controls this bus"
		default SPI2_HOST
		help
			Select SPI peripheral that controls this bus.
		config SPI2_HOST
			bool "SPI2_HOST"
			help
				Use SPI2_HOST. This is also called HSPI_HOST.
		config SPI3_HOST
			depends on IDF_TARGET_ESP32 || IDF_TARGET_ESP32S2 || IDF_TARGET_ESP32S3
			bool "SPI3_HOST"
			help
				USE SPI3_HOST. This is also called VSPI_HOST
	endchoice

endmenu

menu "KEYBOARD Configuration"

	config GPIO_RANGE_MAX
		int
		default 33 if IDF_TARGET_ESP32
		default 46 if IDF_TARGET_ESP32S2
		default 48 if IDF_TARGET_ESP32S3
		default 18 if IDF_TARGET_ESP32C2
		default 19 if IDF_TARGET_ESP32C3
		default 30 if IDF_TARGET_ESP32C6
		default 27 if IDF_TARGET_ESP32H2
	config BOOT_BUTTON
		int "GPIO BOOT Button Pin"
		range 0 GPIO_RANGE_MAX
		default 9 if IDF_TARGET_ESP32C6
		help
			Select the GPIO pin number for the BOOT button.
	config GPIO_LEFT_BUTTON
		int "GPIO LEFT Button Pin"
		range 0 GPIO_RANGE_MAX
		default 1 if BOARD_BADGE
		default 22 if BOARD_MININO
		help
			Select the GPIO pin number for the LEFT button.
	config GPIO_RIGHT_BUTTON
		int "GPIO RIGHT Button Pin"
		range 0 GPIO_RANGE_MAX
		default 15 if BOARD_BADGE
		default 1 if BOARD_MININO
		help
			Select the GPIO pin number for the RIGHT button.
	config GPIO_UP_BUTTON
		int "GPIO UP Button Pin"
		range 0 GPIO_RANGE_MAX
		default 22 if BOARD_BADGE
		default 15 if BOARD_MININO
		help
			Select the GPIO pin number for the UP button.
	config GPIO_DOWN_BUTTON
		int "GPIO DOWN Button Pin"
		range 0 GPIO_RANGE_MAX
		default 23
		help
			Select the GPIO pin number for the DOWN button.
endmenu

menu "Frequency Configuration"

    choice EXAMPLE_MAX_CPU_FREQ
        prompt "Maximum CPU frequency"
        default EXAMPLE_MAX_CPU_FREQ_80 if !IDF_TARGET_ESP32H2
        default EXAMPLE_MAX_CPU_FREQ_96 if IDF_TARGET_ESP32H2
        depends on PM_ENABLE
        help
            Maximum CPU frequency to use for dynamic frequency scaling.

        config EXAMPLE_MAX_CPU_FREQ_80
            bool "80 MHz"
        config EXAMPLE_MAX_CPU_FREQ_96
            bool "96 MHz"
            depends on IDF_TARGET_ESP32H2
        config EXAMPLE_MAX_CPU_FREQ_120
            bool "120 MHz"
            depends on IDF_TARGET_ESP32C2
        config EXAMPLE_MAX_CPU_FREQ_160
            bool "160 MHz"
            depends on !IDF_TARGET_ESP32C2
        config EXAMPLE_MAX_CPU_FREQ_240
            bool "240 MHz"
            depends on IDF_TARGET_ESP32 || IDF_TARGET_ESP32S2 || IDF_TARGET_ESP32S3
    endchoice

    config EXAMPLE_MAX_CPU_FREQ_MHZ
        int
        default 80 if EXAMPLE_MAX_CPU_FREQ_80
        default 96 if EXAMPLE_MAX_CPU_FREQ_96
        default 120 if EXAMPLE_MAX_CPU_FREQ_120
        default 160 if EXAMPLE_MAX_CPU_FREQ_160
        default 240 if EXAMPLE_MAX_CPU_FREQ_240

    choice EXAMPLE_MIN_CPU_FREQ
        prompt "Minimum CPU frequency"
        default EXAMPLE_MIN_CPU_FREQ_10M if !IDF_TARGET_ESP32H2
        default EXAMPLE_MIN_CPU_FREQ_32M if IDF_TARGET_ESP32H2
        depends on PM_ENABLE
        help
            Minimum CPU frequency to use for dynamic frequency scaling.
            Should be set to XTAL frequency or XTAL frequency divided by integer.

        config EXAMPLE_MIN_CPU_FREQ_40M
            bool "40 MHz (use with 40MHz XTAL)"
            depends on XTAL_FREQ_40 || XTAL_FREQ_AUTO || ESP32_XTAL_FREQ_40 || ESP32_XTAL_FREQ_AUTO || !IDF_TARGET_ESP32
        config EXAMPLE_MIN_CPU_FREQ_20M
            bool "20 MHz (use with 40MHz XTAL)"
            depends on XTAL_FREQ_40 || XTAL_FREQ_AUTO || ESP32_XTAL_FREQ_40 || ESP32_XTAL_FREQ_AUTO || !IDF_TARGET_ESP32
        config EXAMPLE_MIN_CPU_FREQ_10M
            bool "10 MHz (use with 40MHz XTAL)"
            depends on XTAL_FREQ_40 || XTAL_FREQ_AUTO || ESP32_XTAL_FREQ_40 || ESP32_XTAL_FREQ_AUTO || !IDF_TARGET_ESP32
        config EXAMPLE_MIN_CPU_FREQ_26M
            bool "26 MHz (use with 26MHz XTAL)"
            depends on XTAL_FREQ_26 || XTAL_FREQ_AUTO || ESP32_XTAL_FREQ_26 || ESP32_XTAL_FREQ_AUTO
        config EXAMPLE_MIN_CPU_FREQ_13M
            bool "13 MHz (use with 26MHz XTAL)"
            depends on XTAL_FREQ_26 || XTAL_FREQ_AUTO || ESP32_XTAL_FREQ_26 || ESP32_XTAL_FREQ_AUTO
        config EXAMPLE_MIN_CPU_FREQ_32M
            bool "32 MHz (use with 32MHz XTAL)"
            depends on IDF_TARGET_ESP32H2
            depends on XTAL_FREQ_32 || XTAL_FREQ_AUTO
    endchoice

    config EXAMPLE_MIN_CPU_FREQ_MHZ
        int
        default 40 if EXAMPLE_MIN_CPU_FREQ_40M
        default 20 if EXAMPLE_MIN_CPU_FREQ_20M
        default 10 if EXAMPLE_MIN_CPU_FREQ_10M
        default 26 if EXAMPLE_MIN_CPU_FREQ_26M
        default 13 if EXAMPLE_MIN_CPU_FREQ_13M
        default 32 if EXAMPLE_MIN_CPU_FREQ_32M
endmenu

menu "Apps & Features"
################################# WIFI ###################################
config WIFI_APPS_ENABLE
    bool "Enable WiFi Apps"
    default true
    help
      Enable or disable all WiFi applications.

if WIFI_APPS_ENABLE

config WIFI_APP_ANALYZER
    bool "Enable Analyzer App"
    default true
    help
      Enable or disable the WiFi Analyzer application.

config WIFI_APP_DEAUTH
    bool "Enable Deauth App"
    default true
    help
      Enable or disable the WiFi Deauth application.

config WIFI_APP_DOS
    bool "Enable DoS App"
    default true
    help
      Enable or disable the WiFi DoS application.

endif # WIFI_APPS_ENABLE

############################### BLUETOOTH #################################

config BLUETOOTH_APPS_ENABLE
    bool "Enable Bluetooth Apps"
    default true
    help
      Enable or disable all Bluetooth applications.

if BLUETOOTH_APPS_ENABLE

config BLUETOOTH_APP_TRAKERS
    bool "Enable Trakers App"
    default true
    help
      Enable or disable the Bluetooth Trakers application.

config BLUETOOTH_APP_SPAM
    bool "Enable Spam App"
    default true
    help
      Enable or disable the Bluetooth Spam application.

config BLUETOOTH_APP_HID
	bool "Enable HID App"
	default true
	help
		Enable or disable the Bluetooth HID application.
endif # BLUETOOTH_APPS_ENABLE

################################# ZIGBEE ###################################

config ZIGBEE_APPS_ENABLE
    bool "Enable Zigbee Apps"
    default true
    help
      Enable or disable all Zigbee applications.

if ZIGBEE_APPS_ENABLE

config ZIGBEE_APP_SPOOFING
    bool "Enable Spoofing App"
    default true
    help
      Enable or disable the Zigbee Spoofing application.

config ZIGBEE_APP_SNIFFER
    bool "Enable Sniffer App"
    default true
    help
      Enable or disable the Zigbee Sniffer application.
endif # ZIGBEE_APPS_ENABLE

################################# THREAD ###################################

config THREAD_APPS_ENABLE
    bool "Enable Thread Apps"
    default true
    help
      Enable or disable all Thread applications.

if THREAD_APPS_ENABLE

config THREAD_APP_BROADCAST
    bool "Enable Boradcast App"
    default true
    help
      Enable or disable the Thread Broadcast application.

config THREAD_APP_SNIFFER
    bool "Enable Sniffer App"
    default true
    help
      Enable or disable the Thread Sniffer application.
endif # THREAD_APPS_ENABLE

################################# GPS ###################################

config GPS_APPS_ENABLE
    bool "Enable GPS Apps"
    default true
    help
      Enable or disable all GPS applications.

if GPS_APPS_ENABLE

config GPS_APP_WARDRIVING
    bool "Enable Wardriving App"
    default true
    help
      Enable or disable the GPS Wardriving application.
endif # GPS_APPS_ENABLE

################################# OTA ###################################

config OTA_ENABLE
    bool "Enable OTA feature"
    default true
    help
      Enable or disable OTA feature.

########################### FILE MANAGER #############################

config FILE_MANAGER_ENABLE
    bool "Enable File Manager Features"
    default true
    help
      Enable or disable all File Manager Features.

if FILE_MANAGER_ENABLE

config FILE_MANAGER_LOCAL
    bool "Enable Local File Manager"
    default true
    help
      Enable or disable the Local File Manager feature.

config FILE_MANAGER_WEB
    bool "Enable Web File Manager"
    default true
    help
      Enable or disable the Web File Manager Feature.
endif # FILE_MANAGER_ENABLE

endmenu
```
